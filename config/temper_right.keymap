#include "chocofi.dtsi"

// Chocofi's right half has the column order mirrored.
&kscan0 {
    col-gpios = <&pro_micro 14 GPIO_ACTIVE_HIGH>,
                <&pro_micro 15 GPIO_ACTIVE_HIGH>,
                <&pro_micro 18 GPIO_ACTIVE_HIGH>,
                <&pro_micro 19 GPIO_ACTIVE_HIGH>,
                <&pro_micro 20 GPIO_ACTIVE_HIGH>;
};
