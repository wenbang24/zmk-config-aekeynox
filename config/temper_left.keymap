#include "chocofi.dtsi"

// Chocofi column wiring; Temper's rows and 36-key transform already match.
// Use per-half files: CONFIG_SHIELD_* is unavailable during DTS processing.
&kscan0 {
    col-gpios = <&pro_micro 20 GPIO_ACTIVE_HIGH>,
                <&pro_micro 19 GPIO_ACTIVE_HIGH>,
                <&pro_micro 18 GPIO_ACTIVE_HIGH>,
                <&pro_micro 15 GPIO_ACTIVE_HIGH>,
                <&pro_micro 14 GPIO_ACTIVE_HIGH>;
};
